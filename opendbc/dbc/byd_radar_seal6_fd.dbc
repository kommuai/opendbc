VERSION ""

# BYD Seal 6 front radar (CAN-FD bus 1).
# Reverse-engineered from stock logs (2026-07-16--06-20-47).
# 16 object frames per cycle: 0x670..0x67f (64 bytes each), trigger on 0x67f.
# Header/status: 0x64e (8B), 0x66f (16B) — not required for track parsing.
#
# VLEAD_KPH @ bit 112: DO NOT USE for control. Route 2026-07-17--01-30-08 shows
# ~71% of "valid" tracks stuck at raw 11775 (~117.8 kph) and many at ~2560 (~25.6 kph)
# sentinels. Treating these as absolute speed caused phantom braking. openpilot derives
# vRel from LONG_DIST rate instead (see radar_interface.py).
#
# Range filtering (radar_interface.py):
# - Publish dRel up to 200m; continuity-validated real tracks die ~65–70m LONG_DIST.
# - Reject sentinel bands: LONG_DIST 138–153m and 175–195m.
# - Reject empty-slot garbage: LONG_DIST >= 210m.
# - No new track birth above 100m dRel unless closing (vRel≈-v_ego) with longer persist;
#   stricter yRel/persistence above 100/140m; drop frozen far tracks (|vRel|≈0).

NS_ :

BS_:

BU_: RADAR

BO_ 1614 RADAR_STATUS_A: 8 RADAR
 SG_ SCAN_INDEX : 0|8@1+ (1,0) [0|255] "" XXX

BO_ 1647 RADAR_STATUS_B: 16 RADAR
 SG_ STATUS_INDEX : 0|8@1+ (1,0) [0|255] "" XXX

BO_ 1648 RADAR_TRACK_00: 64 RADAR
 SG_ SCAN_INDEX : 0|16@1+ (1,0) [0|65535] "" XXX
 SG_ TRACK_ID : 32|8@1+ (1,0) [0|255] "" XXX
 SG_ LONG_DIST : 64|16@1+ (0.01,0) [0|655.35] "m" XXX
 SG_ VLEAD_KPH : 112|16@1+ (0.01,0) [0|655.35] "kph" XXX
 SG_ LAT_DIST : 240|16@1- (0.01,0) [-327.68|327.67] "m" XXX

BO_ 1649 RADAR_TRACK_01: 64 RADAR
 SG_ SCAN_INDEX : 0|16@1+ (1,0) [0|65535] "" XXX
 SG_ TRACK_ID : 32|8@1+ (1,0) [0|255] "" XXX
 SG_ LONG_DIST : 64|16@1+ (0.01,0) [0|655.35] "m" XXX
 SG_ VLEAD_KPH : 112|16@1+ (0.01,0) [0|655.35] "kph" XXX
 SG_ LAT_DIST : 240|16@1- (0.01,0) [-327.68|327.67] "m" XXX

BO_ 1650 RADAR_TRACK_02: 64 RADAR
 SG_ SCAN_INDEX : 0|16@1+ (1,0) [0|65535] "" XXX
 SG_ TRACK_ID : 32|8@1+ (1,0) [0|255] "" XXX
 SG_ LONG_DIST : 64|16@1+ (0.01,0) [0|655.35] "m" XXX
 SG_ VLEAD_KPH : 112|16@1+ (0.01,0) [0|655.35] "kph" XXX
 SG_ LAT_DIST : 240|16@1- (0.01,0) [-327.68|327.67] "m" XXX

BO_ 1651 RADAR_TRACK_03: 64 RADAR
 SG_ SCAN_INDEX : 0|16@1+ (1,0) [0|65535] "" XXX
 SG_ TRACK_ID : 32|8@1+ (1,0) [0|255] "" XXX
 SG_ LONG_DIST : 64|16@1+ (0.01,0) [0|655.35] "m" XXX
 SG_ VLEAD_KPH : 112|16@1+ (0.01,0) [0|655.35] "kph" XXX
 SG_ LAT_DIST : 240|16@1- (0.01,0) [-327.68|327.67] "m" XXX

BO_ 1652 RADAR_TRACK_04: 64 RADAR
 SG_ SCAN_INDEX : 0|16@1+ (1,0) [0|65535] "" XXX
 SG_ TRACK_ID : 32|8@1+ (1,0) [0|255] "" XXX
 SG_ LONG_DIST : 64|16@1+ (0.01,0) [0|655.35] "m" XXX
 SG_ VLEAD_KPH : 112|16@1+ (0.01,0) [0|655.35] "kph" XXX
 SG_ LAT_DIST : 240|16@1- (0.01,0) [-327.68|327.67] "m" XXX

BO_ 1653 RADAR_TRACK_05: 64 RADAR
 SG_ SCAN_INDEX : 0|16@1+ (1,0) [0|65535] "" XXX
 SG_ TRACK_ID : 32|8@1+ (1,0) [0|255] "" XXX
 SG_ LONG_DIST : 64|16@1+ (0.01,0) [0|655.35] "m" XXX
 SG_ VLEAD_KPH : 112|16@1+ (0.01,0) [0|655.35] "kph" XXX
 SG_ LAT_DIST : 240|16@1- (0.01,0) [-327.68|327.67] "m" XXX

BO_ 1654 RADAR_TRACK_06: 64 RADAR
 SG_ SCAN_INDEX : 0|16@1+ (1,0) [0|65535] "" XXX
 SG_ TRACK_ID : 32|8@1+ (1,0) [0|255] "" XXX
 SG_ LONG_DIST : 64|16@1+ (0.01,0) [0|655.35] "m" XXX
 SG_ VLEAD_KPH : 112|16@1+ (0.01,0) [0|655.35] "kph" XXX
 SG_ LAT_DIST : 240|16@1- (0.01,0) [-327.68|327.67] "m" XXX

BO_ 1655 RADAR_TRACK_07: 64 RADAR
 SG_ SCAN_INDEX : 0|16@1+ (1,0) [0|65535] "" XXX
 SG_ TRACK_ID : 32|8@1+ (1,0) [0|255] "" XXX
 SG_ LONG_DIST : 64|16@1+ (0.01,0) [0|655.35] "m" XXX
 SG_ VLEAD_KPH : 112|16@1+ (0.01,0) [0|655.35] "kph" XXX
 SG_ LAT_DIST : 240|16@1- (0.01,0) [-327.68|327.67] "m" XXX

BO_ 1656 RADAR_TRACK_08: 64 RADAR
 SG_ SCAN_INDEX : 0|16@1+ (1,0) [0|65535] "" XXX
 SG_ TRACK_ID : 32|8@1+ (1,0) [0|255] "" XXX
 SG_ LONG_DIST : 64|16@1+ (0.01,0) [0|655.35] "m" XXX
 SG_ VLEAD_KPH : 112|16@1+ (0.01,0) [0|655.35] "kph" XXX
 SG_ LAT_DIST : 240|16@1- (0.01,0) [-327.68|327.67] "m" XXX

BO_ 1657 RADAR_TRACK_09: 64 RADAR
 SG_ SCAN_INDEX : 0|16@1+ (1,0) [0|65535] "" XXX
 SG_ TRACK_ID : 32|8@1+ (1,0) [0|255] "" XXX
 SG_ LONG_DIST : 64|16@1+ (0.01,0) [0|655.35] "m" XXX
 SG_ VLEAD_KPH : 112|16@1+ (0.01,0) [0|655.35] "kph" XXX
 SG_ LAT_DIST : 240|16@1- (0.01,0) [-327.68|327.67] "m" XXX

BO_ 1658 RADAR_TRACK_10: 64 RADAR
 SG_ SCAN_INDEX : 0|16@1+ (1,0) [0|65535] "" XXX
 SG_ TRACK_ID : 32|8@1+ (1,0) [0|255] "" XXX
 SG_ LONG_DIST : 64|16@1+ (0.01,0) [0|655.35] "m" XXX
 SG_ VLEAD_KPH : 112|16@1+ (0.01,0) [0|655.35] "kph" XXX
 SG_ LAT_DIST : 240|16@1- (0.01,0) [-327.68|327.67] "m" XXX

BO_ 1659 RADAR_TRACK_11: 64 RADAR
 SG_ SCAN_INDEX : 0|16@1+ (1,0) [0|65535] "" XXX
 SG_ TRACK_ID : 32|8@1+ (1,0) [0|255] "" XXX
 SG_ LONG_DIST : 64|16@1+ (0.01,0) [0|655.35] "m" XXX
 SG_ VLEAD_KPH : 112|16@1+ (0.01,0) [0|655.35] "kph" XXX
 SG_ LAT_DIST : 240|16@1- (0.01,0) [-327.68|327.67] "m" XXX

BO_ 1660 RADAR_TRACK_12: 64 RADAR
 SG_ SCAN_INDEX : 0|16@1+ (1,0) [0|65535] "" XXX
 SG_ TRACK_ID : 32|8@1+ (1,0) [0|255] "" XXX
 SG_ LONG_DIST : 64|16@1+ (0.01,0) [0|655.35] "m" XXX
 SG_ VLEAD_KPH : 112|16@1+ (0.01,0) [0|655.35] "kph" XXX
 SG_ LAT_DIST : 240|16@1- (0.01,0) [-327.68|327.67] "m" XXX

BO_ 1661 RADAR_TRACK_13: 64 RADAR
 SG_ SCAN_INDEX : 0|16@1+ (1,0) [0|65535] "" XXX
 SG_ TRACK_ID : 32|8@1+ (1,0) [0|255] "" XXX
 SG_ LONG_DIST : 64|16@1+ (0.01,0) [0|655.35] "m" XXX
 SG_ VLEAD_KPH : 112|16@1+ (0.01,0) [0|655.35] "kph" XXX
 SG_ LAT_DIST : 240|16@1- (0.01,0) [-327.68|327.67] "m" XXX

BO_ 1662 RADAR_TRACK_14: 64 RADAR
 SG_ SCAN_INDEX : 0|16@1+ (1,0) [0|65535] "" XXX
 SG_ TRACK_ID : 32|8@1+ (1,0) [0|255] "" XXX
 SG_ LONG_DIST : 64|16@1+ (0.01,0) [0|655.35] "m" XXX
 SG_ VLEAD_KPH : 112|16@1+ (0.01,0) [0|655.35] "kph" XXX
 SG_ LAT_DIST : 240|16@1- (0.01,0) [-327.68|327.67] "m" XXX

BO_ 1663 RADAR_TRACK_15: 64 RADAR
 SG_ SCAN_INDEX : 0|16@1+ (1,0) [0|65535] "" XXX
 SG_ TRACK_ID : 32|8@1+ (1,0) [0|255] "" XXX
 SG_ LONG_DIST : 64|16@1+ (0.01,0) [0|655.35] "m" XXX
 SG_ VLEAD_KPH : 112|16@1+ (0.01,0) [0|655.35] "kph" XXX
 SG_ LAT_DIST : 240|16@1- (0.01,0) [-327.68|327.67] "m" XXX
